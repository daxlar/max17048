## drivers/sensor/max17048a/Kconfig
```kconfig
config MAX17048A
	bool "MAX17048 Fuel Gauge Driver Sensor"
	default n
	depends on I2C
	help
	  Enable driver for the MAX17048 Fuel Gauge Driver Sensor
```

## dts/bindings/sensor/maxim,max17048a.yaml
```yaml
description: Maxim Integrated max17048 Li+ fuel gauge driver sensor

compatible: "maxim,max17048a"

include: ["i2c-device.yaml", "sensor-device.yaml"]

properties:
  reg:
    required: true
    description: device address on i2c bus
```
